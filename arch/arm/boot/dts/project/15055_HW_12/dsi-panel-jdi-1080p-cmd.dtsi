/************************************************************
* Copyright (c) 2013-2013 OPPO Mobile communication Corp.ltd.,
* VENDOR_EDIT
* Description: device tree for jdi cmd panel.
* Version    : 1.0
* Date       : 2013-12-12
* Author     : yangxinqin
 *
 * This program is free software; you can redistribute it and/or modify
 * it under the terms of the GNU General Public License version 2 and
 * only version 2 as published by the Free Software Foundation.
 *
 * This program is distributed in the hope that it will be useful,
 * but WITHOUT ANY WARRANTY; without even the implied warranty of
 * MERCHANTABILITY or FITNESS FOR A PARTICULAR PURPOSE.  See the
 * GNU General Public License for more details.
 */

/*---------------------------------------------------------------------------
 * This file is autogenerated file using gcdb parser. Please do not edit it.
 * Update input XML file to add a new entry or update variable in this file
 * VERSION = "1.0"
 *---------------------------------------------------------------------------*/
&mdss_mdp {
	dsi_jdi_1080_cmd: qcom,mdss_dsi_jdi_1080p_cmd {
		compatible = "qcom,mdss-dsi-panel";
		status = "ok";
		qcom,cont-splash-enabled;
		qcom,mdss-dsi-panel-name = "jdi 1080p cmd mode dsi panel";
		qcom,mdss-dsi-panel-manufacture = "JDI";
		qcom,mdss-dsi-panel-version = "R63417";
		qcom,mdss-dsi-panel-controller = <&mdss_dsi0>;
		qcom,mdss-dsi-panel-type = "dsi_cmd_mode";
		qcom,mdss-dsi-panel-destination = "display_1";
		qcom,mdss-dsi-panel-framerate = <62>;
		qcom,mdss-dsi-virtual-channel-id = <0>;
		qcom,mdss-dsi-stream = <0>;
		qcom,mdss-dsi-panel-width = <1080>;
		qcom,mdss-dsi-panel-height = <1920>;
		qcom,mdss-dsi-h-front-porch = <140>;
		qcom,mdss-dsi-h-back-porch = <70>;
		qcom,mdss-dsi-h-pulse-width = <4>;
		qcom,mdss-dsi-h-sync-skew = <0>;
		qcom,mdss-dsi-v-back-porch = <6>;
		qcom,mdss-dsi-v-front-porch = <8>;
		qcom,mdss-dsi-v-pulse-width = <2>;
		qcom,mdss-dsi-h-left-border = <0>;
		qcom,mdss-dsi-h-right-border = <0>;
		qcom,mdss-dsi-v-top-border = <0>;
		qcom,mdss-dsi-v-bottom-border = <0>;
		qcom,mdss-dsi-bpp = <24>;
		qcom,mdss-dsi-underflow-color = <0x00>;
		qcom,mdss-dsi-border-color = <0>;
		qcom,mdss-dsi-on-command = [39 01 00 00 01 00 05 2a 00 00 04 37
                                    39 01 00 00 01 00 05 2b 00 00 07 7f
                                    23 01 00 00 01 00 02 b0 04
									29 01 00 00 01 00 1f c7 00 0B 10 19 27 33 3D 4C 32 39 45 57 6A 74 7F 00 0B 10 19 27 33 3D 4C 32 39 45 57 6A 74 7F
                                    29 01 00 00 01 00 14 c8 01 0A FD 03 01 E8 00 00 03 FC F5 A1 00 00 01 FD 06 FC 00
                                    29 01 00 00 01 00 21 ca 01 80 89 90 C0 80 90 90 10 3F 14 89 0A 4A 37 A0 55 F8 0C 0C 20 10 3F 3F 00 E6 06 0C 0C 0C 0C 0C
									29 01 00 00 01 00 18 CE 75 40 43 49 55 62 71 82 94 A8 B9 CB DB E9 F5 FC FF 04 00 04 04 44 20
									29 01 00 00 01 00 07 B8 03 90 1E 10 1E 32
									29 01 00 00 01 00 07 B9 03 82 3C 10 3C 87
									29 01 00 00 01 00 07 BA 03 78 64 10 64 B4
                                    23 01 00 00 00 00 02 d6 01
                                    23 01 00 00 01 00 02 b0 03
									39 01 00 00 01 00 02 51 ff
									15 01 00 00 01 00 02 55 03
                                    15 01 00 00 01 00 02 53 2c
                                    05 01 00 00 78 00 02 11 00
                                    15 01 00 00 11 00 02 36 00
                                    15 01 00 00 01 00 02 3a 77
                                    39 01 00 00 01 00 03 44 00 00
                                    15 01 00 00 01 00 02 35 00                                                                                       
                                    05 01 00 00 01 00 02 29 00];
		qcom,mdss-dsi-off-command = [05 01 00 00 32 00 02 28 00
                                     05 01 00 00 78 00 02 10 00];
		qcom,mdss-dsi-on-command-state = "dsi_lp_mode";
		qcom,mdss-dsi-off-command-state = "dsi_hs_mode";
		qcom,mdss-dsi-h-sync-pulse = <1>;
		qcom,mdss-dsi-traffic-mode = "burst_mode";
		qcom,mdss-dsi-bllp-eof-power-mode;
		qcom,mdss-dsi-bllp-power-mode;
		qcom,mdss-dsi-lane-0-state;
		qcom,mdss-dsi-lane-1-state;
		qcom,mdss-dsi-lane-2-state;
		qcom,mdss-dsi-lane-3-state;
		qcom,mdss-dsi-te-pin-select = <1>;
		qcom,mdss-dsi-te-v-sync-rd-ptr-irq-line = <0x2c>;
		qcom,mdss-dsi-te-v-sync-continue-lines = <0x3c>;
		qcom,mdss-dsi-te-dcs-command = <1>;
		qcom,mdss-dsi-te-check-enable;
		qcom,mdss-dsi-te-using-te-pin;




	
		qcom,mdss-dsi-panel-timings = [f9 3d 34 00 58 4d 36 3f 53 03 04 00];
		qcom,mdss-dsi-t-clk-post = <0x1e>;
		qcom,mdss-dsi-t-clk-pre = <0x38>;
		qcom,mdss-dsi-bl-min-level = <1>;
		qcom,mdss-dsi-bl-max-level = <255>;
		qcom,mdss-dsi-dma-trigger = "trigger_sw";
		qcom,mdss-dsi-mdp-trigger = "trigger_sw";
		qcom,mdss-dsi-bl-pmic-control-type = "bl_ctrl_wled";
		qcom,mdss-dsi-reset-sequence = <1 20>, <0 5>, <1 20>;
		/*yxr add begin for CABC*/
		qcom,mdss-dsi-cabc-off-command = [15 01 00 00 10 00 02 55 00
										  05 01 00 00 10 00 02 29 00];
		qcom,mdss-dsi-cabc-ui-command = [15 01 00 00 10 00 02 55 01
										 05 01 00 00 10 00 02 29 00];
		qcom,mdss-dsi-cabc-still-image-command = [15 01 00 00 10 00 02 55 02
												  05 01 00 00 10 00 02 29 00];
		qcom,mdss-dsi-cabc-video-command = [15 01 00 00 10 00 02 55 03
										    05 01 00 00 10 00 02 29 00];
		qcom,mdss-dsi-gamma1 = [23 01 00 00 01 00 02 b0 04
								29 01 00 00 01 00 14 c8 01 0A FD 03 01 E8 00 00 03 FC F5 A1 00 00 01 FD 06 FC 00
								23 01 00 00 00 00 02 d6 01
								23 01 00 00 01 00 02 b0 03
								];							
		qcom,mdss-dsi-gamma2 = [23 01 00 00 01 00 02 b0 04
								29 01 00 00 01 00 14 c8 01 00 F0 F4 00 D5 00 00 E8 E6 02 BA 00 00 00 00 00 00 00
								23 01 00 00 00 00 02 d6 01
								23 01 00 00 01 00 02 b0 03
								];
		qcom,mdss-dsi-gamma3 = [23 01 00 00 01 00 02 b0 04
								29 01 00 00 01 00 14 c8 01 00 F0 F4 00 D5 00 00 00 00 00 00 00 00 F0 F0 00 FC 00
								23 01 00 00 00 00 02 d6 01
								23 01 00 00 01 00 02 b0 03
								];
		qcom,mdss-dsi-gamma4 = [23 01 00 00 01 00 02 b0 04
								29 01 00 00 01 00 14 c8 01 00 00 00 00 00 00 00 E8 E6 02 BA 00 00 F0 F0 00 FC 00
								23 01 00 00 00 00 02 d6 01
								23 01 00 00 01 00 02 b0 03
								];
		/*yxr add end*/
	};
};
