/* Copyright (c) 2013, The Linux Foundation. All rights reserved.
 *
 * This program is free software; you can redistribute it and/or modify
 * it under the terms of the GNU General Public License version 2 and
 * only version 2 as published by the Free Software Foundation.
 *
 * This program is distributed in the hope that it will be useful,
 * but WITHOUT ANY WARRANTY; without even the implied warranty of
 * MERCHANTABILITY or FITNESS FOR A PARTICULAR PURPOSE.  See the
 * GNU General Public License for more details.
 */

qcom,atl-4v35-2530mAh-data {
	qcom,fcc-mah = <2450>;
	qcom,default-rbatt-mohm = <160>;
	qcom,rbatt-capacitive-mohm = <0>;
	qcom,flat-ocv-threshold-uv = <3800000>;
	qcom,max-voltage-uv = <4320000>;
	qcom,v-cutoff-uv = <3400000>;
	qcom,chg-term-ua = <150000>;
	qcom,batt-id-kohm = <10>;
	qcom,battery-type = "ATL"; // add by xcb

	qcom,rbatt-sf-lut {
		qcom,lut-col-legend = <(-20) 0 25 40 60>;
		qcom,lut-row-legend = <100 95 90 85 80>,
				<75 70 65 60 55>,
				<50 45 40 35 30>,
				<25 20 16 13 11>,
				<10 9 8 7 6>,
				<5 4 3 2 1>;
		qcom,lut-data = <1569 340 100 78 70>,
				<1568 340 100 78 70>,
				<1450 342 101 79 71>,
				<1385 339 104 81 71>,
				<1283 342 108 84 73>,
				<1224 351 116 89 75>,
				<1209 300 115 88 78>,
				<1195 299 123 94 80>,
				<1195 294 114 94 81>,
				<1208 289 98 80 72>,
				<1226 289 96 78 71>,
				<1254 292 97 79 71>,
				<1289 298 99 81 73>,
				<1332 308 101 84 75>,
				<1384 322 101 84 75>,
				<1446 339 100 79 71>,
				<1515 358 100 79 71>,
				<1573 374 101 80 72>,
				<1594 385 100 79 71>,
				<1525 385 99 78 71>,
				<1556 394 100 79 72>,
				<1584 407 102 81 73>,
				<1641 422 105 83 75>,
				<1727 436 108 86 77>,
				<1865 450 110 86 75>,
				<2030 461 107 82 72>,
				<2248 478 108 82 74>,
				<2575 509 111 85 75>,
				<3278 556 118 89 80>,
				<6556 1112 154 118 106>;
	};

	qcom,fcc-temp-lut {
		qcom,lut-col-legend = <(-20) 0 25 40 60>;
		qcom,lut-data = <2500 2513 2514 2511 2504>;
	};

	qcom,pc-temp-ocv-lut {
		qcom,lut-col-legend = <(-20) 0 25 40 60>;
		qcom,lut-row-legend = <100 95 90 85 80>,
				<75 70 65 60 55>,
				<50 45 40 35 30>,
				<25 20 16 13 11>,
				<10 9 8 7 6>,
				<5 4 3 2 1 0>;
		qcom,lut-data = <4312 4312 4308 4305 4299>,	/* 100 */
				<4208 4237 4242 4240 4237>,
				<4138 4182 4188 4186 4182>,
				<4092 4132 4136 4134 4130>,
				<4013 4086 4088 4086 4082>,	/* 80 */
				<3947 4036 4046 4042 4036>,
				<3908 3955 3983 3989 3993>,
				<3872 3921 3954 3956 3954>,
				<3845 3889 3910 3914 3912>,	/* 60 */
				<3825 3858 3867 3868 3866>,
				<3810 3832 3840 3840 3838>,
				<3797 3810 3818 3818 3816>,
				<3784 3794 3800 3800 3798>,	/* 40 */
				<3771 3782 3784 3785 3783>,
				<3758 3772 3770 3768 3762>,
				<3742 3759 3755 3747 3735>,
				<3724 3742 3737 3728 3714>,	/* 20 */
				<3704 3724 3718 3710 3696>,
				<3688 3710 3698 3690 3676>,
				<3675 3702 3691 3683 3671>,
				<3666 3698 3690 3682 3670>,	/* 10 */
				<3656 3694 3688 3680 3668>,
				<3644 3690 3686 3678 3666>,
				<3630 3682 3682 3674 3662>,
				<3612 3670 3671 3664 3648>,
				<3590 3645 3643 3635 3614>,	/* 5 */
				<3560 3600 3596 3588 3566>,
				<3515 3538 3534 3529 3506>,
				<3438 3448 3449 3446 3423>,
				<3302 3296 3311 3316 3294>,	/* 1 */
				<3000 3000 3000 3000 3016>;
	};
};

